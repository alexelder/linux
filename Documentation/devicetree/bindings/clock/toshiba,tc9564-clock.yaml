## Documentation/devicetree/bindings/clock/toshiba,tc9564-clock.yaml
```yaml
# SPDX-License-Identifier: (GPL-2.0-only OR BSD-2-Clause)
%YAML 1.2
---
$id: http://devicetree.org/schemas/clock/toshiba,tc9564-clock.yaml#
$schema: http://devicetree.org/meta-schemas/core.yaml#

title: Toshiba TC9564 Clock Controller

maintainers:
  - Alex Elder <elder@riscstar.com>
  - Daniel Thompson <daniel@riscstar.com>

description:
  The Toshiba TC9564 is an SoC accessed by a host system through the
  upstream PCIe port on the PCIe switch it implements.  The switch
  includes an embedded PCIe endpoint that provides access to various
  SoC peripherals (including a clock controller) via its BARs.

  A total of 21 clocks are implemented, though two of these are not
  controllable.  Access to the clock controller relies on PCIe being
  functional, so the PCIe clock is assumed to be always on.  Similarly,
  the PCIe controller relies on I2C, so the I2C clock is also assumed
  to be always on.

  Clock ids are defined in <dt-bindings/clock/toshiba,tc9564.h>.

  The clock controller uses registers within the same page as a
  reset controller, so both devices are defined as children of a
  "config" syscon.

properties:
  compatible:
    const: toshiba,tc9564-clock

  "#clock-cells":
    const: 1

required:
  - compatible
  - "#clock-cells"

unevaluatedProperties: false

examples:
  - |
    syscon@0 {
        compatible = "syscon", "simple-mfd";
        reg = <0x0 0x2000>;

        clock-controller {
            compatible = "toshiba,tc9564-clock";
            #clock-cells = <1>;
        };
    };
```

## Documentation/devicetree/bindings/clock/toshiba,tc9564-clocks.yaml
```yaml
# SPDX-License-Identifier: (GPL-2.0-only OR BSD-2-Clause)
%YAML 1.2
---
$id: http://devicetree.org/schemas/clock/toshiba,tc9564-clocks.yaml#
$schema: http://devicetree.org/meta-schemas/core.yaml#

title: Toshiba TC956x Clock Controller

maintainers:
  - Alex Elder <elder@riscstar.com>
  - Daniel Thompson <daniel@riscstar.com>

description: |
  The TC956x clock controller provides gate clocks for internal IP
  blocks including the MCU, SRAM, interrupt controller, UART, MSIGEN,
  PLL, SGMII, and the two Ethernet MACs.

  The clock registers are accessed through the parent
  "toshiba,tc9564-config-syscon" syscon regmap.  Two reg entries
  specify the offsets of the clock control registers (CLKCTRL0 and
  CLKCTRL1) within that regmap.

  Clock indices are defined in
  <dt-bindings/clock/toshiba,tc9564.h>.

properties:
  compatible:
    const: toshiba,tc9564-clocks

  reg:
    items:
      - description: Offset and size of CLKCTRL0 register
      - description: Offset and size of CLKCTRL1 register

  "#clock-cells":
    const: 1

required:
  - compatible
  - reg
  - "#clock-cells"

unevaluatedProperties: false

examples:
  - |
    #include <dt-bindings/clock/toshiba,tc9564.h>

    clock@1004 {
        compatible = "toshiba,tc9564-clocks";
        reg = <0x1004 0x4>, <0x100c 0x4>;
        #clock-cells = <1>;
    };
```

## Documentation/devicetree/bindings/interrupt-controller/toshiba,tc9564-msigen.yaml
```yaml
# SPDX-License-Identifier: (GPL-2.0-only OR BSD-2-Clause)
%YAML 1.2
---
$id: http://devicetree.org/schemas/interrupt-controller/toshiba,tc9564-msigen.yaml#
$schema: http://devicetree.org/meta-schemas/core.yaml#

title: Toshiba TC956x MSIGEN Interrupt Controller

maintainers:
  - Alex Elder <elder@riscstar.com>
  - Daniel Thompson <daniel@riscstar.com>

description: |
  The TC956x MSIGEN (MSI Generator) provides an interrupt controller
  with 25 hardware interrupt lines.  It aggregates internal interrupts
  and generates a single PCIe MSI to the host.

  The MSIGEN requires a clock and reset from the TC956x clock and
  reset controllers.  Function 0 provides MSIGEN at offset 0xf000;
  function 1 provides a separate instance at offset 0xf100.

properties:
  compatible:
    const: toshiba,tc9564-msigen

  reg:
    maxItems: 1

  interrupt-controller: true

  "#interrupt-cells":
    const: 1

  clocks:
    maxItems: 1
    description: MSIGEN gate clock from the TC956x clock controller

  clock-names:
    const: toshiba,tc9564-msigen-clock

  resets:
    maxItems: 1
    description: MSIGEN reset from the TC956x reset controller

  reset-names:
    const: toshiba,tc9564-msigen-reset

required:
  - compatible
  - reg
  - interrupt-controller
  - "#interrupt-cells"
  - clocks
  - clock-names
  - resets
  - reset-names

unevaluatedProperties: false

examples:
  - |
    #include <dt-bindings/clock/toshiba,tc9564.h>
    #include <dt-bindings/reset/toshiba,tc9564.h>

    interrupt-controller@f000 {
        compatible = "toshiba,tc9564-msigen";
        reg = <0xf000 0x100>;

        interrupt-controller;
        #interrupt-cells = <1>;

        clocks = <&clock0 CLOCK_MSIGEN>;
        clock-names = "toshiba,tc9564-msigen-clock";
        resets = <&reset0 RESET_MSIGEN>;
        reset-names = "toshiba,tc9564-msigen-reset";
    };
```

## Documentation/devicetree/bindings/mfd/toshiba,tc9564.yaml
```yaml
# SPDX-License-Identifier: (GPL-2.0-only OR BSD-2-Clause)
%YAML 1.2
---
$id: http://devicetree.org/schemas/mfd/toshiba,tc9564.yaml#
$schema: http://devicetree.org/meta-schemas/core.yaml#

title: Toshiba TC9564 System Controller

maintainers:
  - Alex Elder <elder@riscstar.com>
  - Daniel Thompson <daniel@riscstar.com>

description: |
  The Toshiba TC9564 is an SoC accessed by a host system through the
  upstream PCIe port on the PCIe switch it implements.  The switch includes
  an embedded PCIe endpoint on one of its downstream ports that provides
  access to various SoC peripherals (including a clock and reset controller)
  via one of its BARs.  A system controller provides managed access to the
  first two pages of this memory region to ensure accesses made by these
  peripherals produce well-defined results.

properties:
  compatible:
    items:
      - const: toshiba,tc9564-config
      - const: syscon
      - const: simple-mfd

  reg:
    maxItems: 1

  ranges: true

  '#address-cells':
    const: 1

  '#size-cells':
    const: 1

required:
  - compatible
  - reg

unevaluatedProperties: false

examples:
  - |
    syscon@0 {
        compatible = "toshiba,tc9564-config",
                     "syscon",
                     "simple-mfd";
        reg = <0x0 0x2000>;
        #address-cells = <1>;
        #size-cells = <1>;
        ranges;
    };
```

## Documentation/devicetree/bindings/misc/toshiba,tc9564-translate.yaml
```yaml
# SPDX-License-Identifier: (GPL-2.0-only OR BSD-2-Clause)
%YAML 1.2
---
$id: http://devicetree.org/schemas/misc/toshiba,tc9564-translate.yaml#
$schema: http://devicetree.org/meta-schemas/core.yaml#

title: Toshiba TC956x AXI-to-PCIe Address Translation

maintainers:
  - Alex Elder <elder@riscstar.com>
  - Daniel Thompson <daniel@riscstar.com>

description: |
  The TC956x AXI-to-PCIe address translation unit translates between
  the internal AXI bus address space (above 64 GB, starting at
  0x10_0000_0000) and PCIe bus address space.  The Ethernet MACs
  access the PCIe subsystem via this bus.

  The translation unit has four AXI translation table entries, each
  with eight 4-byte registers.  Currently only the first entry is
  used, mapping the 64 GB AXI address region to PCIe bus address 0x0.

properties:
  compatible:
    const: toshiba,tc9564-translate

  reg:
    maxItems: 1
    description:
      Offset and size of the translation table registers within the
      bridge syscon regmap.

  toshiba,bridge-syscon:
    $ref: /schemas/types.yaml#/definitions/phandle-array
    description:
      Phandle to the TC956x bridge syscon (compatible
      "toshiba,tc9564-bridge-syscon") plus an offset argument giving
      the base of the translation table registers within the regmap.
    items:
      - items:
          - description: Phandle to the bridge syscon
          - description: Offset of the translation table

required:
  - compatible
  - reg
  - toshiba,bridge-syscon

unevaluatedProperties: false

examples:
  - |
    translate@800 {
        compatible = "toshiba,tc9564-translate";
        reg = <0x0800 0x80>;
        toshiba,bridge-syscon = <&bridge_syscon 0x0800>;
    };
```

## Documentation/devicetree/bindings/reset/toshiba,tc9564-resets.yaml
```yaml
# SPDX-License-Identifier: (GPL-2.0-only OR BSD-2-Clause)
%YAML 1.2
---
$id: http://devicetree.org/schemas/reset/toshiba,tc9564-resets.yaml#
$schema: http://devicetree.org/meta-schemas/core.yaml#

title: Toshiba TC956x Reset Controller

maintainers:
  - Alex Elder <elder@riscstar.com>
  - Daniel Thompson <daniel@riscstar.com>

description: |
  The TC956x reset controller provides reset controls for internal IP
  blocks including the MCU, MCU1, interrupt controller, UART, MSIGEN,
  and the two Ethernet MACs (MAC, PMA, and XPCS resets each).

  The reset registers are accessed through the parent
  "toshiba,tc9564-config-syscon" syscon regmap.  Two reg entries
  specify the offsets of the reset control registers (RSTCTRL0 and
  RSTCTRL1) within that regmap.

  Reset indices are defined in
  <dt-bindings/reset/toshiba,tc9564.h>.

properties:
  compatible:
    const: toshiba,tc9564-resets

  reg:
    items:
      - description: Offset and size of RSTCTRL0 register
      - description: Offset and size of RSTCTRL1 register

  "#reset-cells":
    const: 1

required:
  - compatible
  - reg
  - "#reset-cells"

unevaluatedProperties: false

examples:
  - |
    #include <dt-bindings/reset/toshiba,tc9564.h>

    reset@1008 {
        compatible = "toshiba,tc9564-resets";
        reg = <0x1008 0x4>, <0x1010 0x4>;
        #reset-cells = <1>;
    };
```

## drivers/net/ethernet/toshiba/tc956x/Kconfig
```kconfig
# SPDX-License-Identifier: GPL-2.0-only
#
# Toshiba TC956x configuration
#

config TC956X_NET
	tristate "TC956x/QPS615 Ethernet driver"
	depends on PCI
	help
	  This driver supports the TC965x/QPS615 ethernet audio-video bridging
	  (AVB)/time-sensitive networking (TSN) bridge.
```

## kernel/Kconfig.freezer
```kconfig
# SPDX-License-Identifier: GPL-2.0-only
config FREEZER
	def_bool PM_SLEEP || CGROUP_FREEZER

config READ_DATA
	bool "enable the read_data system call"
	default y
	help
		Enable support for the read_data() system call, which returns
		a fixed long value through a buffer provided by the caller.
```
